## talon-zmk/config/boards/shields/talon/KConfig.shield
```kconfig
config SHIELD_TALON_LEFT
	def_bool $(shields_list_contains,talon_left)

config SHIELD_TALON_RIGHT
	def_bool $(shields_list_contains,talon_right)

config SHIELD_TALON_DONGLE
	def_bool $(shields_list_contains,talon_dongle)
```

## talon-zmk/config/boards/shields/talon/Kconfig.defconfig
```kconfig
# Copyright (c) 2020 The ZMK Contributors
# SPDX-License-Identifier: MIT

config ZMK_BLE
	default y

if SHIELD_TALON_DONGLE || SHIELD_TALON_LEFT || SHIELD_TALON_RIGHT

config ZMK_KEYBOARD_NAME
	default "Talon"

config ZMK_SPLIT
	default y

endif

if SHIELD_TALON_DONGLE

config ZMK_SPLIT_BLE_ROLE_CENTRAL
	default y

config ZMK_USB
	default y

endif
```
