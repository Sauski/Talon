/*
 * Copyright (c) 2020 The ZMK Contributors
 *
 * SPDX-License-Identifier: MIT
 */

#include "talon.dtsi"

// No idea why this is required for the dongle..

/ {
	kscan0: kscan {
		compatible = "zmk,kscan-gpio-direct";
		label = "KSCAN";
		input-gpios = <&gpio0 15 (GPIO_ACTIVE_LOW | GPIO_PULL_UP)>;
	};
};